/*
 * romcalls.s - trampolines from the firmware into the boot ROM (EBR).
 *
 * To avoid duplicating SHA-512 code, this provides an ABI for firmware
 * to call into the boot ROM's TweetNaCl's SHA-512 functions.
 *
 * Each stub: the caller's ra (which the C call just set) is saved on
 * the stack, the absolute ROM address is loaded, the call is made, and
 * ra is restored before returning. Arguments (a0-a7) and the return
 * value (a0) are passed through, sp is lowered by 16 during the call
 * (keeps sp 16-byte aligned at the ROM's entry, per the psABI),
 * and t0 (scratch) is clobbered.
 *
 * The ROM addresses are injected as -D flags by the build (see
 * firmware/Makefile), generated by rom/tools/make_romapi.py from the linked
 * ROM (build/rom.elf). The C prototypes are in romapi.h.
 */
.equ ROM_SHA512, FK_ROM_SHA512
.equ ROM_SHA512_BLOCKS, FK_ROM_SHA512_BLOCKS

    .section .text
    .type fk_rom_hash_sha512, @function
    .globl fk_rom_hash_sha512
fk_rom_hash_sha512:
    addi  sp, sp, -16
    sw    ra, 0(sp)
    lui   t0, %hi(ROM_SHA512)
    addi  t0, t0, %lo(ROM_SHA512)
    jalr  ra, 0(t0)
    lw    ra, 0(sp)
    addi  sp, sp, 16
    ret

    .type fk_rom_hashblocks_sha512, @function
    .globl fk_rom_hashblocks_sha512
fk_rom_hashblocks_sha512:
    addi  sp, sp, -16
    sw    ra, 0(sp)
    lui   t0, %hi(ROM_SHA512_BLOCKS)
    addi  t0, t0, %lo(ROM_SHA512_BLOCKS)
    jalr  ra, 0(t0)
    lw    ra, 0(sp)
    addi  sp, sp, 16
    ret
